## examples/esp-idf/05_lvgl_axp2101/main/Kconfig.projbuild
```kconfig
menu "XPowersLib Configuration"

    choice PMU_Type
        prompt "XPowers chip type"
        default XPOWERS_CHIP_AXP2101 if IDF_TARGET_ESP32
        default XPOWERS_CHIP_AXP192
        help
            Defines the default peripheral for xpowers example

        config XPOWERS_CHIP_AXP2101
            bool "Xpowers AXP2101"
        config XPOWERS_CHIP_AXP192
            bool "Xpowers AXP192"
    endchoice

    choice I2C_COMMUNICATION_METHOD
        prompt "XPowersLIb read and write methods"
        default I2C_COMMUNICATION_METHOD_BUILTIN_RW
        help
            Define XPowersLIb read and write methods

        config I2C_COMMUNICATION_METHOD_BUILTIN_RW
            bool "Implemented using built-in read and write methods"
        config I2C_COMMUNICATION_METHOD_CALLBACK_RW
            bool "Implemented using read and write callback methods"
    endchoice

    config I2C_MASTER_PORT_NUM
        int "PMU I2C Port Number"
        default 1
        help
            Port number for I2C Master device.

    config I2C_MASTER_FREQUENCY
        int "Master Frequency"
        default 100000
        help
            I2C Speed of Master device.

    config PMU_I2C_SCL
        int "PMU SCL GPIO Num"
        default 22
        help
            GPIO number for I2C PMU clock line.

    config PMU_I2C_SDA
        int "PMU SDA GPIO Num"
        default 21
        help
            GPIO number for I2C PMU data line.

    config PMU_INTERRUPT_PIN
        int "PMU Interrupt Pin"
        default 35
        help
            PMU interrupt pin.


endmenu

# LVGL 8 has none of these LVGL 9 decoder options. Keep them disabled so
# the component resolver can evaluate newer LVGL candidates on ESP-IDF 5.5.
# Remove these compatibility symbols when migrating this example to LVGL 9.
config LV_USE_LIBJPEG_TURBO
    bool "LVGL 9 libjpeg-turbo compatibility flag (keep disabled)"
    default n

config LV_USE_LIBPNG
    bool "LVGL 9 libpng compatibility flag (keep disabled)"
    default n

config LV_USE_LZ4
    bool "LVGL 9 LZ4 compatibility flag (keep disabled)"
    default n
```

## examples/factory/components/Weather/Kconfig
```kconfig
menu "S3 3.5 Weather"
    config S35_WEATHER_API_ID
        string "Existing C5 weather API ID"
        default "10015813"
    config S35_WEATHER_API_KEY
        string "Existing C5 weather API key"
        default "070d8d7113bef63bbad7216a89cb00a4"
    config S35_WEATHER_PROVINCE
        string "Province sent to API (UTF-8)"
        default "广东"
    config S35_WEATHER_CITY
        string "City sent to API (UTF-8)"
        default "深圳"
    config S35_WEATHER_CITY_LABEL
        string "City display name"
        default "Shenzhen"
endmenu
```

## examples/factory/components/esp32_s3_touch_lcd_3_5/Kconfig
```kconfig
menu "ESP32-S3 Touch LCD 3.5 BSP"
    config BSP_LCD_POWERON_RESTART
        bool "Preserve original LCD cold-start software restart"
        default y
        help
            Restart once after creating LCD SPI IO on a power-on reset,
            as in the original 260911 factory firmware.
    config BSP_LCD_SPI_CLOCK_HZ
        int "LCD SPI clock (Hz)"
        range 10000000 80000000
        default 80000000
    config BSP_LCD_BUFFER_HEIGHT
        int "LVGL DMA draw buffer height"
        range 10 80
        default 10
    config BSP_LCD_BRIGHTNESS
        int "Initial backlight percentage"
        range 0 100
        default 80
endmenu
```

## examples/factory/sdkconfig.defaults
```kconfig
CONFIG_IDF_TARGET="esp32s3"
CONFIG_ESPTOOLPY_FLASHMODE_DIO=y
CONFIG_ESPTOOLPY_FLASHFREQ_80M=y
CONFIG_ESPTOOLPY_FLASHSIZE_16MB=y
CONFIG_PARTITION_TABLE_CUSTOM=y
CONFIG_PARTITION_TABLE_CUSTOM_FILENAME="partitions.csv"
CONFIG_SPIRAM=y
CONFIG_SPIRAM_MODE_OCT=y
CONFIG_SPIRAM_SPEED_80M=y
CONFIG_SPIRAM_USE_MALLOC=y
CONFIG_SPIRAM_MALLOC_ALWAYSINTERNAL=0
CONFIG_SPIRAM_MALLOC_RESERVE_INTERNAL=32768
CONFIG_ESP_DEFAULT_CPU_FREQ_MHZ_240=y
CONFIG_ESP_MAIN_TASK_STACK_SIZE=8192
CONFIG_FREERTOS_HZ=1000
CONFIG_COMPILER_OPTIMIZATION_PERF=y
CONFIG_LV_COLOR_DEPTH_16=y
CONFIG_LV_DEF_REFR_PERIOD=20
CONFIG_LV_USE_CLIB_MALLOC=y
CONFIG_LV_USE_CLIB_STRING=y
CONFIG_LV_USE_CLIB_SPRINTF=y
CONFIG_LV_OS_FREERTOS=y
CONFIG_LV_DRAW_THREAD_STACK_SIZE=8192
CONFIG_LV_USE_SNAPSHOT=y
CONFIG_LV_USE_QRCODE=y
CONFIG_LV_FONT_MONTSERRAT_16=y
CONFIG_LV_FONT_MONTSERRAT_20=y
CONFIG_LV_FONT_MONTSERRAT_24=y
CONFIG_LV_USE_SYSMON=n
CONFIG_LV_BUILD_EXAMPLES=n
CONFIG_LV_BUILD_DEMOS=n
CONFIG_FATFS_LFN_HEAP=y
CONFIG_FATFS_MAX_LFN=255
CONFIG_FATFS_API_ENCODING_UTF_8=y
CONFIG_SENSORLIB_ESP_IDF_NEW_API=y
CONFIG_XPOWERS_CHIP_AXP2101=y
# All peripherals share the new i2c_master bus; legacy codec I2C conflicts at boot.
CONFIG_CODEC_I2C_BACKWARD_COMPATIBLE=n

# APP framework: Phone only, matching the RLCD application lifecycle.
CONFIG_ESP_BROOKESIA_ENABLE_AI_FRAMEWORK=n
CONFIG_ESP_BROOKESIA_ENABLE_GUI=y
CONFIG_ESP_BROOKESIA_GUI_ENABLE_ANIM_PLAYER=n
CONFIG_ESP_BROOKESIA_GUI_ENABLE_SQUARELINE=y
CONFIG_ESP_BROOKESIA_ENABLE_SERVICES=n
CONFIG_ESP_BROOKESIA_ENABLE_SYSTEMS=y
CONFIG_ESP_BROOKESIA_SYSTEMS_ENABLE_PHONE=y
CONFIG_ESP_BROOKESIA_SYSTEMS_ENABLE_SPEAKER=n
CONFIG_LV_FONT_MONTSERRAT_12=y
CONFIG_LV_FONT_MONTSERRAT_18=y
CONFIG_LV_FONT_MONTSERRAT_32=y
CONFIG_LV_FONT_MONTSERRAT_48=y
CONFIG_LV_FONT_SOURCE_HAN_SANS_SC_16_CJK=y

# Network time matches RLCD: Aliyun first, with pool.ntp.org as fallback.
CONFIG_LWIP_SNTP_MAX_SERVERS=2
CONFIG_LWIP_SNTP_UPDATE_DELAY=3600000

# Xiaozhi: single-mic WakeNet, queues/codec working buffers use PSRAM.
CONFIG_SPIRAM_ALLOW_STACK_EXTERNAL_MEMORY=y
CONFIG_SR_WN_WN9_NIHAOXIAOZHI_TTS=y
CONFIG_XIAOZHI_APP_UI_LANGUAGE_ENGLISH=y
CONFIG_XIAOZHI_APP_TRANSPORT_WEBSOCKET=y
CONFIG_XIAOZHI_INFO_TIMEOUT_MS=8000
CONFIG_XIAOZHI_SYNC_SYSTEM_TIME_FROM_SERVER=n
CONFIG_MBEDTLS_EXTERNAL_MEM_ALLOC=y
```
